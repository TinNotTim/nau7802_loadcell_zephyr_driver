## drivers/sensor/nau7802_loadcell/Kconfig
```kconfig
# Copyright (c) 2024, Tin Chiang.
# SPDX-License-Identifier: Apache-2.0

menuconfig NAU7802_LOADCELL
	bool "NAU7802 24-Bit Dual-Channel ADC with Loadcell"
	default y
	# depends on DT_HAS_ZEPHYR_NAU7802_LOADCELL_ENABLED
    select I2C
	help
	  Enable driver for NAU7802 24-Bit Dual-Channel ADC For loadcell.
	  Noted: NAU7802 can be used with multiple bridge sensor, but this driver is specifically designed for loadcell
if NAU7802_LOADCELL

choice NAU7802_LOADCELL_TRIGGER_MODE
	prompt "Trigger mode"
	default NAU7802_LOADCELL_TRIGGER_GLOBAL_THREAD
	help
	  Specify the type of triggering to be used by the driver.

config NAU7802_LOADCELL_TRIGGER_NONE
	bool "No trigger"

config NAU7802_LOADCELL_TRIGGER_GLOBAL_THREAD
	bool "Use global thread"
	select NAU7802_LOADCELL_TRIGGER

config NAU7802_LOADCELL_TRIGGER_OWN_THREAD
	bool "Use own thread"
	select NAU7802_LOADCELL_TRIGGER

config NAU7802_LOADCELL_TRIGGER_DIRECT
	bool "Use IRQ handler"
	select NAU7802_LOADCELL_TRIGGER
endchoice

config NAU7802_LOADCELL_TRIGGER
	bool
# if NAU7802_LOADCELL_TRIGGER

config NAU7802_LOADCELL_THREAD_PRIORITY
	int "Own thread priority"
	depends on NAU7802_LOADCELL_TRIGGER_OWN_THREAD
	default 10
	help
	  Priority of the thread used by the driver to handle interrupts.

config NAU7802_LOADCELL_THREAD_STACK_SIZE
	int "Own thread stack size"
	depends on NAU7802_LOADCELL_TRIGGER_OWN_THREAD
	default 1024
	help
	  Stack size of thread used by the driver to handle interrupts.

# endif #NAU7802_LOADCELL_TRIGGER
endif #NAU7802_LOADCELL
```

## dts/bindings/sensor/nau7802_loadcell/nuvoton,nau7802_loadcell.yaml
```yaml
# Copyright (c) 2024, Tin Chiang
# SPDX-License-Identifier: Apache-2.0

description: |
  Nuvoton NAU7802 24-Bit Dual-Channel ADC For Bridge Sensors on I2C bus.
  
  Example definition in devicetree:

    nau7802_loadcell {
        compatible = "nuvoton,nau7802_loadcell";
        drdy-gpios = <&gpio0 0 (GPIO_PULL_UP | GPIO_ACTIVE_LOW)>;
    };
  

compatible: "nuvoton,nau7802_loadcell"

include: [sensor-device.yaml, i2c-device.yaml]

properties:
  drdy-gpios:
    type: phandle-array
    description: |
      DRDY pin

      This pin defaults to active high when produced by the sensor.
      The property value should ensure the flags properly describe
      the signal that is presented to the driver.

      The interrupt pin of NAU7802 is default active high.
  conversions-per-second:
    
    type: int
    default: 0
    # Note: the driver relies on the ordering of this enum,
    # so change it with care.    
    description: |
      Number of force readings performed by the NAU7802 per second.
      10 conversions per second is the power-on reset configuration.
    enum: 
      - 10 # SPS
      - 20 #SPS
      - 40 #SPS
      - 80 #SPS
      - 320 #SPS
  gain:
    type: int
    default: 1    
    description: |
      ADC gain factor. The default value is x1 at power on.
    enum:
      - 1
      - 2
      - 4
      - 8
      - 16
      - 32
      - 64
      - 128
  # calibration-factor:
  #   type: string
  #   default: "1.0"
  #   description: |
  #     The sensor model of loadcell is 'y = ax + b'. The calibration factor is the 'a', and should be measured before-hand.
```
